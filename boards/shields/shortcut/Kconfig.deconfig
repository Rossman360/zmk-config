## boards/shields/shortcut/Kconfig.deconfig
```kconfig
if SHIELD_SHORTCUT

# Name must be less than 16 characters long!
config ZMK_KEYBOARD_NAME
    default "Shortcut"

endif
```

## boards/shields/shortcut/Kconfig.shield
```kconfig
# No whitespace after the comma or in your keyboard name!
config SHIELD_SHORTCUT
    def_bool $(shields_list_contains,shortcut)
```
